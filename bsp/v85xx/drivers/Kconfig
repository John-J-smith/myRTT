## bsp/v85xx/drivers/Kconfig
```kconfig
menu "Hardware Drivers Config"

config SOC_HT6x3x
    bool
    select SOC_SERIES_HT6XXX
    select RT_USING_COMPONENTS_INIT
    select RT_USING_USER_MAIN
    default y

menu "Onboard Peripheral Drivers"

	config BSP_USING_EEPROM
        bool "Enable eeprom"
        select BSP_USING_I2C
        default y
		
	config BSP_USING_FLASH
        bool "Enable data flash"
        select BSP_USING_SPI
        default y

endmenu

menu "On-chip Peripheral Drivers"

	config BSP_USING_WDT
        bool "Enable watch dog timer"
        default y
		
    config BSP_USING_GPIO
        bool "Enable GPIO"
        select RT_USING_PIN
        default y

    menuconfig BSP_USING_UART
        bool "Enable UART"
        default y
        select RT_USING_SERIAL
        if BSP_USING_UART
			config BSP_USING_UART0
                bool "Enable UART0"
                default y
				
            config BSP_USING_UART1
                bool "Enable UART1"
                default n
				
			config BSP_USING_UART2
                bool "Enable UART2"
                default n
				
			config BSP_USING_UART3
                bool "Enable UART3"
                default n
				
			config BSP_USING_UART4
                bool "Enable UART4"
                default n
				
			config BSP_USING_UART5
                bool "Enable UART5"
                default n
			
			config BSP_UART_USING_DMA_TX
				bool "Enable UART TX DMA support"
				default y
				
			config BSP_UART_USING_DMA_RX
				bool "Enable UART RX DMA support"
				default n
			
        endif
		
	config BSP_USING_I2C
            bool "Enable I2C BUS"
            select RT_USING_I2C
            select RT_USING_I2C_BITOPS
            default n
	
	menuconfig BSP_USING_SPI
            bool "Enable SPI BUS"
			select RT_USING_SPI
            select RT_USING_PIN
			default n
			if BSP_USING_SPI
				config BSP_USING_SPI1
					bool "Enable SPI1"
					default y
				
				config BSP_USING_SPI2
					bool "Enable SPI2"
					default n
			endif
endmenu

menu "Board extended module Drivers"

endmenu

endmenu
```
